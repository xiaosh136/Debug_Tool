; ARM load script
screen.on
SYStem.RESet
SYStem.CPU Cortexa5
SYStem.Up

&psd=os.psd()
&dump_dir="8910dump"
;&ap_elf_file="appimage.elf"
&cp_elf_file="8915DM_cat1_open_core.elf"

;DATA.LOAD.ELF &dump_dir\&ap_elf_file /NOCLEAR
DATA.LOAD.ELF &dump_dir\&cp_elf_file /NOCLEAR

DATA.LOAD.BINARY &dump_dir\80000000.bin 0x80000000 /NOCLEAR
DATA.LOAD.BINARY &dump_dir\00000000.bin 0x0 /NOCLEAR
DATA.LOAD.BINARY &dump_dir\00800000.bin 0x800000 /NOCLEAR
DATA.LOAD.BINARY &dump_dir\40080000.bin 0x40080000 /NOCLEAR
DATA.LOAD.BINARY &dump_dir\50000000.bin 0x50000000 /NOCLEAR
DATA.LOAD.BINARY &dump_dir\50030000.bin 0x50030000 /NOCLEAR
DATA.LOAD.BINARY &dump_dir\50080000.bin 0x50080000 /NOCLEAR
DATA.LOAD.BINARY &dump_dir\50081000.bin 0x50081000 /NOCLEAR
DATA.LOAD.BINARY &dump_dir\50083000.bin 0x50083000 /NOCLEAR
DATA.LOAD.BINARY &dump_dir\50084000.bin 0x50084000 /NOCLEAR
DATA.LOAD.BINARY &dump_dir\50090000.bin 0x50090000 /NOCLEAR
DATA.LOAD.BINARY &dump_dir\50094000.bin 0x50094000 /NOCLEAR
DATA.LOAD.BINARY &dump_dir\500a0000.bin 0x500a0000 /NOCLEAR
DATA.LOAD.BINARY &dump_dir\50100000.bin 0x50100000 /NOCLEAR
DATA.LOAD.BINARY &dump_dir\50104000.bin 0x50104000 /NOCLEAR
DATA.LOAD.BINARY &dump_dir\50105000.bin 0x50105000 /NOCLEAR
DATA.LOAD.BINARY &dump_dir\50109000.bin 0x50109000 /NOCLEAR
DATA.LOAD.BINARY &dump_dir\5010a004.bin 0x5010a004 /NOCLEAR
DATA.LOAD.BINARY &dump_dir\5010c000.bin 0x5010c000 /NOCLEAR
DATA.LOAD.BINARY &dump_dir\50308000.bin 0x50308000 /NOCLEAR
DATA.LOAD.BINARY &dump_dir\08800000.bin 0x8800000 /NOCLEAR
DATA.LOAD.BINARY &dump_dir\08800800.bin 0x8800800 /NOCLEAR
DATA.LOAD.BINARY &dump_dir\08808000.bin 0x8808000 /NOCLEAR
DATA.LOAD.BINARY &dump_dir\08809000.bin 0x8809000 /NOCLEAR
DATA.LOAD.BINARY &dump_dir\0880e000.bin 0x880e000 /NOCLEAR
DATA.LOAD.BINARY &dump_dir\0880f004.bin 0x880f004 /NOCLEAR
DATA.LOAD.BINARY &dump_dir\08814000.bin 0x8814000 /NOCLEAR
DATA.LOAD.BINARY &dump_dir\08815000.bin 0x8815000 /NOCLEAR
DATA.LOAD.BINARY &dump_dir\09000000.bin 0x9000000 /NOCLEAR
DATA.LOAD.BINARY &dump_dir\090c0000.bin 0x90c0000 /NOCLEAR
DATA.LOAD.BINARY &dump_dir\10040000.bin 0x10040000 /NOCLEAR
DATA.LOAD.BINARY &dump_dir\14110000.bin 0x14110000 /NOCLEAR
DATA.LOAD.BINARY &dump_dir\25000000.bin 0x25000000 /NOCLEAR
DATA.LOAD.BINARY &dump_dir\25100000.bin 0x25100000 /NOCLEAR
DATA.LOAD.BINARY &dump_dir\25200000.bin 0x25200000 /NOCLEAR
DATA.LOAD.BINARY &dump_dir\25300000.bin 0x25300000 /NOCLEAR
DATA.LOAD.BINARY &dump_dir\25400000.bin 0x25400000 /NOCLEAR
DATA.LOAD.BINARY &dump_dir\25500000.bin 0x25500000 /NOCLEAR
DATA.LOAD.BINARY &dump_dir\25600000.bin 0x25600000 /NOCLEAR
DATA.LOAD.BINARY &dump_dir\25700000.bin 0x25700000 /NOCLEAR
DATA.LOAD.BINARY &dump_dir\25800000.bin 0x25800000 /NOCLEAR
DATA.LOAD.BINARY &dump_dir\25900000.bin 0x25900000 /NOCLEAR
DATA.LOAD.BINARY &dump_dir\25a00000.bin 0x25a00000 /NOCLEAR
DATA.LOAD.BINARY &dump_dir\25b00000.bin 0x25b00000 /NOCLEAR
DATA.LOAD.BINARY &dump_dir\26000000.bin 0x26000000 /NOCLEAR
DATA.LOAD.BINARY &dump_dir\26000800.bin 0x26000800 /NOCLEAR
DATA.LOAD.BINARY &dump_dir\27000000.bin 0x27000000 /NOCLEAR
DATA.LOAD.BINARY &dump_dir\40000000.bin 0x40000000 /NOCLEAR
DATA.LOAD.BINARY &dump_dir\400a0000.bin 0x400a0000 /NOCLEAR
DATA.LOAD.BINARY &dump_dir\22000000.bin 0x22000000 /NOCLEAR

Register.Set cpsr Data.Long(D:0x80002840)
Register.Set r0 Data.Long(D:0x80002800)
Register.Set r1 Data.Long(D:0x80002804)
Register.Set r2 Data.Long(D:0x80002808)
Register.Set r3 Data.Long(D:0x8000280c)
Register.Set r4 Data.Long(D:0x80002810)
Register.Set r5 Data.Long(D:0x80002814)
Register.Set r6 Data.Long(D:0x80002818)
Register.Set r7 Data.Long(D:0x8000281c)
Register.Set r8 Data.Long(D:0x80002820)
Register.Set r9 Data.Long(D:0x80002824)
Register.Set r10 Data.Long(D:0x80002828)
Register.Set r11 Data.Long(D:0x8000282c)
Register.Set r12 Data.Long(D:0x80002830)
Register.Set r13 Data.Long(D:0x80002834)
Register.Set r14 Data.Long(D:0x80002838)
Register.Set spsr Data.Long(D:0x80002844)
Register.Set pc Data.Long(D:0x8000283c)
PER.Set.simple C15:0x1 %Long Data.Long(D:0x80002848)
PER.Set.simple C15:0x2 %Long Data.Long(D:0x8000284c)
PER.Set.simple C15:0x3 %Long 0x55555555

MENU.REPROGRAM &psd\freertos\freertos.men
TASK.CONFIG &psd\freertos\freertos.t32
