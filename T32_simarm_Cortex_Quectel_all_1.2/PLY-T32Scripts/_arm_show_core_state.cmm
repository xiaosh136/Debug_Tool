

;;;;;;;;;;;;;;;;;;;;;;;;;;;;;;;;;;;;;;;;;;;;;;;;;;;;;;;;;;;;;;;;;;;;;;;;;;;;;;;;;;;;;;;;;;;;;;;;;;;;;;;;;;;;
;;                                                                                                        ;;
;;                                Copyright (c) 2019-2020 by Pizer.Fan                                    ;;
;;                                                                                                        ;;
;;  This software is copyrighted by and is the sole property of Pizer.Fan. All rights, title, ownership,  ;;
;;  or other interests in the software remain the property of Pizer.Fan. Any unauthorized use,            ;;
;;  duplication, transmission, distribution, or disclosure of this software is expressly forbidden.       ;;
;;  This Copyright notice may not be removed or modified without prior written consent of Pizer.Fan       ;;
;;                                                                                                        ;;
;;;;;;;;;;;;;;;;;;;;;;;;;;;;;;;;;;;;;;;;;;;;;;;;;;;;;;;;;;;;;;;;;;;;;;;;;;;;;;;;;;;;;;;;;;;;;;;;;;;;;;;;;;;;

;;;;;;;;;;;;;;;;;;;;;;;;;;;;;;;;;;;;;;;;;;;;;;;;;;;;;;;;;;;;;;;;;;;;;;;;;;;;;;;;;;;;;;;;;;;;;;;;;;;;;;;;;;;;
;;  TX Component                                                                                          ;;
;;                                                                                                        ;;
;;    Basic: Show the basic info of cores (subsystem)                                                     ;;
;;                                                                                                        ;;
;;;;;;;;;;;;;;;;;;;;;;;;;;;;;;;;;;;;;;;;;;;;;;;;;;;;;;;;;;;;;;;;;;;;;;;;;;;;;;;;;;;;;;;;;;;;;;;;;;;;;;;;;;;;

;;;;;;;;;;;;;;;;;;;;;;;;;;;;;;;;;;;;;;;;;;;;;;;;;;;;;;;;;;;;;;;;;;;;;;;;;;;;;;;;;;;;;;;;;;;;;;;;;;;;;;;;;;;;
;;  Release History                                                                                       ;;
;;                                                                                                        ;;
;;    Date              Name                      Description                                             ;;
;;                                                                                                        ;;
;;  2020/08/07      Pizer.Fan                   Initial Version                                           ;;
;;                                                                                                        ;;
;;;;;;;;;;;;;;;;;;;;;;;;;;;;;;;;;;;;;;;;;;;;;;;;;;;;;;;;;;;;;;;;;;;;;;;;;;;;;;;;;;;;;;;;;;;;;;;;;;;;;;;;;;;;

local &cli_quiet
entry &cli_quiet
&cli_quiet=&cli_quiet

&curr_script_dir=os.ppd()

; Create logging output window
area.create show_core_state_win 200. 500.
area.select show_core_state_win
area.view show_core_state_win

global &_global_export_dir

;;;;;;;;;;;;;;;;;;;;;;;;;;;;;;;;;;;;;;;;;;;;;;;;;;;;;;;;;;;;;;;;;;;;;;;;;;;;;;;;;;;;;;;;;;;;;;;;;;;;;;;;;;;;
;;  Start ...                                                                                             ;;
;;;;;;;;;;;;;;;;;;;;;;;;;;;;;;;;;;;;;;;;;;;;;;;;;;;;;;;;;;;;;;;;;;;;;;;;;;;;;;;;;;;;;;;;;;;;;;;;;;;;;;;;;;;;

; V3 ? V4 ?
if (symbol.exist(modem_assert_info))
(
  &modem_assert_info_cnt=v.value(sizeof(modem_assert_info)/sizeof(modem_assert_info[0]))
  &assert_core_cnt=0
  &nest_assert_flag=0
  if (v.value(modem_assert_info[0].assert_cnt)>v.value("0"))
  (
    &assert_core_cnt=&assert_core_cnt+1
    if (v.value(modem_assert_info[0].assert_cnt)>v.value("1"))
    (
      &nest_assert_flag=1
    )
  )
  if (v.value(modem_assert_info[1].assert_cnt)>v.value("0"))
  (
    &assert_core_cnt=&assert_core_cnt+1
    if (v.value(modem_assert_info[1].assert_cnt)>v.value("1"))
    (
      &nest_assert_flag=1
    )
  )
  if (v.value(modem_assert_info[2].assert_cnt)>v.value("0"))
  (
    &assert_core_cnt=&assert_core_cnt+1
    if (v.value(modem_assert_info[2].assert_cnt)>v.value("1"))
    (
      &nest_assert_flag=1
    )
  )
  if (v.value(modem_assert_info[3].assert_cnt)>v.value("0"))
  (
    &assert_core_cnt=&assert_core_cnt+1
    if (v.value(modem_assert_info[3].assert_cnt)>v.value("1"))
    (
      &nest_assert_flag=1
    )
  )
  if (v.value(modem_assert_info[4].assert_cnt)>v.value("0"))
  (
    &assert_core_cnt=&assert_core_cnt+1
    if (v.value(modem_assert_info[4].assert_cnt)>v.value("1"))
    (
      &nest_assert_flag=1
    )
  )
  
  ; nest abort ?
  if (v.value(&nest_assert_flag)==v.value("1"))
  (
    if (v.value(modem_assert_info[0].assert_cnt)>v.value("1"))
    (
      print "PS core [0] nest abort!"
    )
    if (v.value(modem_assert_info[1].assert_cnt)>v.value("1"))
    (
      print "PS core [1] nest abort!"
    )
    if (&modem_assert_info_cnt==4)
    (
      if (v.value(modem_assert_info[2].assert_cnt)>v.value("1"))
      (
        print "PHY core [0] nest abort!"
      )
      if (v.value(modem_assert_info[3].assert_cnt)>v.value("1"))
      (
        print "PHY core [1] nest abort!"
      )
    )
    else
    (
      if (v.value(modem_assert_info[2].assert_cnt)>v.value("1"))
      (
        print "V3PHY core nest abort!"
      )
      if (v.value(modem_assert_info[3].assert_cnt)>v.value("1"))
      (
        print "NRPHY core [0] nest abort!"
      )
      if (v.value(modem_assert_info[4].assert_cnt)>v.value("1"))
      (
        print "NRPHY core [1] nest abort!"
      )
    )
  )
  
  ; block ?
  if (v.value(&assert_core_cnt)>v.value("0"))&&(v.value(&assert_core_cnt)<v.value("5"))
  (
    if (v.value(modem_assert_info[0].assert_cnt)==v.value("0"))
    (
      print "PS core [0] block!"
    )
    if (v.value(modem_assert_info[1].assert_cnt)==v.value("0"))
    (
      print "PS core [1] block!"
    )
    if (&modem_assert_info_cnt==4)
    (
      if (v.value(modem_assert_info[2].assert_cnt)==v.value("0"))
      (
        print "PHY core [0] block!"
      )
      if (v.value(modem_assert_info[3].assert_cnt)==v.value("0"))
      (
        print "PHY core [1] block!"
      )
    )
    else
    (
      if (v.value(modem_assert_info[2].assert_cnt)==v.value("0"))
      (
        print "V3PHY core block!"
      )
      if (v.value(modem_assert_info[3].assert_cnt)==v.value("0"))
      (
        print "NRPHY core [0] block!"
      )
      if (v.value(modem_assert_info[4].assert_cnt)==v.value("0"))
      (
        print "NRPHY core [1] block!"
      )
    )

    if ("&cli_quiet"!="1")
    (
      print "Do you want to locate the PC registers of the block cores from the *.ass file [Y|*N]: "
      enter &confirm
      if ("&confirm"=="y")||("&confirm"=="Y")
      (
        print "Plesae select the correct .ass file: "
        local &ass_file_name
        if "&(_global_export_dir)"==""
        (
          dialog.file.open "*.ass"
        )
        else
        (
          dialog.file.open "&_global_export_dir/*.ass"
        )
        entry %line &ass_file_name
        if ("&ass_file_name"!="")
        (
          print "&ass_file_name"
          find &ass_file_name , "NRCP"
          if found()==true()
          (
            &line_no=track.line()
            print "Find the PC registers at &ass_file_name(&line_no) "
            TYPE &ass_file_name &line_no /linenumbers
          )
          ;local &myline
          ;open #1 &ass_file_name /read
          ;read #1 %line &myline
          ;while !file.eof(1)
          ;(
          ;  if string.compare("&myline", "NRCP ")==true()
          ;  (
          ;    print &myline
          ;  )
          ;  if string.compare("&myline", "PSCP ")==true()
          ;  (
          ;    print &myline
          ;  )
          ;  if string.compare("&myline", "V3PHY ")==true()
          ;  (
          ;    print &myline
          ;  )
          ;  read #1 %line &myline
          ;)
          ;close #1
        )
      )
      print ""
    )
  )
)

;;;;;;;;;;;;;;;;;;;;;;;;;;;;;;;;;;;;;;;;;;;;;;;;;;;;;;;;;;;;;;;;;;;;;;;;;;;;;;;;;;;;;;;;;;;;;;;;;;;;;;;;;;;;
;; Current Mode                                                                                           ;;
;;;;;;;;;;;;;;;;;;;;;;;;;;;;;;;;;;;;;;;;;;;;;;;;;;;;;;;;;;;;;;;;;;;;;;;;;;;;;;;;;;;;;;;;;;;;;;;;;;;;;;;;;;;;

local &core_name 
local &sys_id
if symbol.exist(LOG_magicHeader)
(
  local &core_nums
  local &assert_info_offset
  &modem_assert_info_cnt=v.value(sizeof(modem_assert_info)/sizeof(modem_assert_info[0]))
  
  &core_name=data.string(d:v.value(LOG_magicHeader.coreName))
  print "core_name: &core_name"
  
  if (&modem_assert_info_cnt==4)
  (
    if ("&core_name"=="PS")
    (
      &sys_id=0
      &core_nums=2
      &assert_info_offset=0 ; modem_assert_info[0], [1] 
    )
    else if ("&core_name"=="PHY")
    (
      &sys_id=1
      &core_nums=2
      &assert_info_offset=2 ; modem_assert_info[2], [3]
    )
    else
    (
      &sys_id=-1
    )
  )
  else
  (
    if ("&core_name"=="PS")
    (
      &sys_id=0
      &core_nums=2
      &assert_info_offset=0 ; modem_assert_info[0], [1] 
    )
    else if ("&core_name"=="V3-PHY")
    (
      &sys_id=1
      &core_nums=1
      &assert_info_offset=2 ; modem_assert_info[2]
    )
    else if ("&core_name"=="NR")
    (
      &sys_id=2
      &core_nums=2
      &assert_info_offset=3 ; modem_assert_info[3], [4]
    )
    else
    (
      &sys_id=-1
    )
  )

  if (v.value(&sys_id)!=v.value("-1"))
  (
    &core_index=0
    while &core_index<&core_nums
    (
      &assert_debug_info_addr=V.Value((ASSERT_DEBUG_T *)(&modem_assert_info[&core_index+&assert_info_offset].assert_debug_info[0]))
      &current_exception_type=V.Value(modem_assert_info[&core_index+&assert_info_offset].assert_debug_info[0].assert_info.exception_type)
      &current_r14=V.Value(((ASSERT_DEBUG_T *)&assert_debug_info_addr)->reg_info.core_reg.cur_mode_reg.r14)
      &current_cpsr=V.Value(((ASSERT_DEBUG_T *)&assert_debug_info_addr)->reg_info.core_reg.cur_mode_reg.CPSR)
      &current_spsr=V.Value(((ASSERT_DEBUG_T *)&assert_debug_info_addr)->reg_info.core_reg.cur_mode_reg.SPSR)
      &current_cpsr_mode=(&current_cpsr&0x1f)
      &current_spsr_mode=(&current_spsr&0x1f)
      &svc_mode_reg_addr=V.Value((OTHER_REG_T *)&(((ASSERT_DEBUG_T *)&assert_debug_info_addr)->reg_info.core_reg.svc_mode_reg))
      &abort_DFSR_reg=V.Value(((ASSERT_DEBUG_T *)&assert_debug_info_addr)->reg_info.mpu_reg.abort_DFSR_reg)
      &abort_FAR_reg=V.Value(((ASSERT_DEBUG_T *)&assert_debug_info_addr)->reg_info.mpu_reg.abort_FAR_reg)
      
      global &_global_psr_i &_global_psr_f &_global_psr_t &_global_psr_mode &_global_psr_mode_name
      do "&curr_script_dir\_arm_analyze_xpsr.cmm" "&current_cpsr"
      print "the current mode is &current_cpsr: &_global_psr_mode_name mode {i:&_global_psr_i,f:&_global_psr_f,t:&_global_psr_t}."
      do "&curr_script_dir\_arm_analyze_xpsr.cmm" "&current_spsr"
      print "the previous mode is &current_spsr: &_global_psr_mode_name mode {i:&_global_psr_i,f:&_global_psr_f,t:&_global_psr_t}."
      
      print "Core &core_index exception type is &current_exception_type"
      
      if &current_cpsr_mode==0x13
      (
        print "the current mode is svc mode."
      )
      else if &current_cpsr_mode==0x12
      (
        print "the current mode is irq mode."
      )
      else if (&current_cpsr_mode==0x17)
      (
        if (&current_exception_type==0x4)      ;data abort
        (
          print "the current mode is data abort mode."
          if (v.value(&(abort_DFSR_reg)&0xF)==v.value("0x1"))&&(v.value(&(abort_DFSR_reg)&0x400)==v.value("0x0"))
          (
            ; 0xxxxxx0001b
            print "DFSR:0x" &(abort_DFSR_reg) ": Alignment fault!"
          )
          else if (v.value(&(abort_DFSR_reg)&0xF)==v.value("0x0"))&&(v.value(&(abort_DFSR_reg)&0x400)==v.value("0x0"))
          (
            ; 0xxxxxx0001b
            print "DFSR:0x" &(abort_DFSR_reg) ": Background fault!"
          )
          else if (v.value(&(abort_DFSR_reg)&0xF)==v.value("0xD"))&&(v.value(&(abort_DFSR_reg)&0x400)==v.value("0x0"))
          (
            ; 0xxxxxx1101b
            print "DFSR:0x" &(abort_DFSR_reg) ": Permission fault!"
          )
          else if (v.value(&(abort_DFSR_reg)&0xF)==v.value("0x6"))&&(v.value(&(abort_DFSR_reg)&0x400)==v.value("0x400"))
          (
            ; 1xxxxxx0110b
            print "DFSR:0x" &(abort_DFSR_reg) ": Asynchronous external abort!"
          )
        )
        else if (&current_exception_type==0x3) ;prefetch abort
        (
          print "the current mode is prefetch abort mode."
        )
      )
      else if &current_cpsr_mode==0x1b
      (
        ;undef instr
        print "the current mode is undef instr mode."
      )
      
      &core_index=&core_index+1
    )
  )
)
else if (symbol.exist(s_exception_type)&&symbol.exist(cur_mode_reg))
(
  local &curr_r14
  local &curr_cpsr
  local &curr_spsr
  local &curr_cpsr_mode
  local &curr_spsr_mode
  local &curr_exception_type
  local &cur_mode_reg_address
  local &svc_mode_reg_address
  
  &cur_mode_reg_address=v.value(&cur_mode_reg)
  &svc_mode_reg_address=v.value(&svc_mode_reg)
  &curr_r14=V.Value(*((uint32*)(&cur_mode_reg_address+56)))
  &curr_cpsr=V.Value(*((uint32*)(&cur_mode_reg_address+68)))
  &curr_spsr=V.Value(*((uint32*)(&cur_mode_reg_address+64)))
  &curr_cpsr_mode=(&curr_cpsr&0x1f)
  &curr_spsr_mode=(&curr_spsr&0x1f)
  &curr_exception_type=v.value(s_exception_type)
  
  local &abort_DFSR_reg
  local &abort_FAR_reg
  if (symbol.exist(abort_DFSR_reg)&&v.value("sizeof(abort_DFSR_reg)")!=v.value("0"))
  (
    &abort_DFSR_reg=V.Value(abort_DFSR_reg)
    &abort_FAR_reg=V.Value(abort_FAR_reg)
  )
  else
  (
    &abort_DFSR_reg=0
    &abort_FAR_reg=0
  )
  
  global &_global_psr_i &_global_psr_f &_global_psr_t &_global_psr_mode &_global_psr_mode_name
  do "&curr_script_dir\_arm_analyze_xpsr.cmm" "&curr_cpsr"
  print "the current mode is &curr_cpsr: &_global_psr_mode_name mode {i:&_global_psr_i,f:&_global_psr_f,t:&_global_psr_t}."
  do "&curr_script_dir\_arm_analyze_xpsr.cmm" "&curr_spsr"
  print "the previous mode is &curr_spsr: &_global_psr_mode_name mode {i:&_global_psr_i,f:&_global_psr_f,t:&_global_psr_t}."

)

;;;;;;;;;;;;;;;;;;;;;;;;;;;;;;;;;;;;;;;;;;;;;;;;;;;;;;;;;;;;;;;;;;;;;;;;;;;;;;;;;;;;;;;;;;;;;;;;;;;;;;;;;;;;
;; ETB State                                                                                              ;;
;;;;;;;;;;;;;;;;;;;;;;;;;;;;;;;;;;;;;;;;;;;;;;;;;;;;;;;;;;;;;;;;;;;;;;;;;;;;;;;;;;;;;;;;;;;;;;;;;;;;;;;;;;;;
if (symbol.exist(s_ref_param))
(
  ;
  ;    sys_id:0        sys_id:1        sys_id:2
  ;  cs_eb_enable    cs_eb_enable    cs_eb_enable
  ;    0x11            0x00            0x00              => etb: enabled, active to sys_id:0    
  ;    0x10            0x01            0x00              => etb: enabled, active to sys_id:1    
  ;    0x10            0x00            0x01              => etb: enabled, active to sys_id:1 
  ;    0x0*            0x0*            0x0*              => etb: disabled
  ;
  &cs_eb_enable=v.value(s_ref_param.cs_eb_enable)
  if (v.value(&cs_eb_enable&0x10)==v.value("0x10"))
  (
    ; of course, the current is sys_id:0
    if (v.value(&cs_eb_enable&0x0F)==v.value("0x1"))
    (
      print "ETB is enabled & choosed for the current subsys(&core_name) !"
    )
    else
    (
      print "ETB is enabled, but not choosed for the current subsys(&core_name) !"
    )
  )
  else if (v.value(&cs_eb_enable&0x01)==v.value("0x00"))
  (
    print "ETB is enabled? but not choosed for the current subsys(&core_name) !"
  )
  else if (v.value(&cs_eb_enable&0x01)==v.value("0x01"))
  (
    print "ETB is enabled & choosed for the current subsys(&core_name) ?!"
  )
)

;;;;;;;;;;;;;;;;;;;;;;;;;;;;;;;;;;;;;;;;;;;;;;;;;;;;;;;;;;;;;;;;;;;;;;;;;;;;;;;;;;;;;;;;;;;;;;;;;;;;;;;;;;;;
;; Current Threads                                                                                        ;;
;;;;;;;;;;;;;;;;;;;;;;;;;;;;;;;;;;;;;;;;;;;;;;;;;;;;;;;;;;;;;;;;;;;;;;;;;;;;;;;;;;;;;;;;;;;;;;;;;;;;;;;;;;;;

print "Current threads in TX:"
print "{"
&core_nums=v.value("sizeof(_tx_thread_current_ptr)/sizeof(TX_THREAD *)")
if (&core_nums==v.value("1"))
(
  ;v.w _tx_thread_current_ptr _tx_thread_execute_ptr _tx_thread_system_state
  if (v.value(_tx_thread_current_ptr)!=v.value(0))
  (
    &thread_name=v.value((_tx_thread_current_ptr)->tx_thread_name)
    print "  _tx_thread_current_ptr: " "0x" v.value(_tx_thread_current_ptr) " " data.string(d:&thread_name)
  )
  else
  (
    print "  _tx_thread_current_ptr: " "0x0"
  )
  if (v.value(_tx_thread_execute_ptr)!=v.value(0))
  (
    &thread_name=v.value((_tx_thread_execute_ptr)->tx_thread_name)
    print "  _tx_thread_execute_ptr: " "0x" v.value(_tx_thread_execute_ptr) " " data.string(d:&thread_name)
  )
  else
  (
    print "  _tx_thread_execute_ptr: " "0x0"
  )
  print "  _tx_thread_system_state: " "0x" v.value(_tx_thread_system_state)
  if (v.value(_tx_thread_current_ptr)==v.value(0))&&(v.value(_tx_thread_execute_ptr)==v.value(0))
  (
    print "  Seems core standby?"
  )
  else if (v.value(_tx_thread_current_ptr)==v.value(0))&&(v.value(_tx_thread_execute_ptr)!=v.value(0))&&(v.value(_tx_thread_system_state)!=v.value(0))
  (
    &thread_name=v.value((_tx_thread_execute_ptr)->tx_thread_name)
    print "  Seems IRQ is breaking the thread: " data.string(d:&thread_name)
  )
)
else if (&core_nums==v.value("2"))
(
  &i=0
  while (&i<&core_nums)
  (
    if (v.value(_tx_thread_current_ptr[&i])!=v.value(0))
    (
      &thread_name=v.value((_tx_thread_current_ptr[0])->tx_thread_name)
      print "  _tx_thread_current_ptr[&i]: " "0x" v.value(_tx_thread_current_ptr[&i]) " " data.string(d:&thread_name)
    )
    else
    (
      print "  _tx_thread_current_ptr[&i]: " "0x0"
    )
    if (v.value(_tx_thread_execute_ptr[&i])!=v.value(0))
    (
      &thread_name=v.value((_tx_thread_execute_ptr[&i])->tx_thread_name)
      print "  _tx_thread_execute_ptr[&i]: " "0x" v.value(_tx_thread_execute_ptr[&i]) " " data.string(d:&thread_name)
    )
    else
    (
      print "  _tx_thread_execute_ptr[&i]: " "0x0"
    )
    print "  _tx_thread_system_state[&i]: " "0x" v.value(_tx_thread_system_state[&i])
    if (v.value(_tx_thread_current_ptr[&i])==v.value(0))&&(v.value(_tx_thread_execute_ptr[&i])==v.value(0))
    (
      print "  Seems core &i standby?"
    )
    else if (v.value(_tx_thread_current_ptr[&i])==v.value(0))&&(v.value(_tx_thread_execute_ptr[&i])!=v.value(0))&&(v.value(_tx_thread_system_state[&i])!=v.value(0))
    (
      &thread_name=v.value((_tx_thread_execute_ptr[&i])->tx_thread_name)
      print "  Seems IRQ is breaking the thread: " data.string(d:&thread_name)
    )
    &i=&i+1
  )
)

print "}"


;;;;;;;;;;;;;;;;;;;;;;;;;;;;;;;;;;;;;;;;;;;;;;;;;;;;;;;;;;;;;;;;;;;;;;;;;;;;;;;;;;;;;;;;;;;;;;;;;;;;;;;;;;;;
;;  End                                                                                                   ;;
;;;;;;;;;;;;;;;;;;;;;;;;;;;;;;;;;;;;;;;;;;;;;;;;;;;;;;;;;;;;;;;;;;;;;;;;;;;;;;;;;;;;;;;;;;;;;;;;;;;;;;;;;;;;

CMM_END:
area.select show_core_state_win

enddo

