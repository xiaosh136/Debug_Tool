LOCAL &CUR_DIR &file_path
LOCAL &soc_funnel_value &print_string &dir_path

&CUR_DIR=OS.PPD()

ON ERROR CONTinue
GOSUB dump_etb 0x80301000 "phycp_core0_etb"
GOSUB dump_etb 0x80302000 "phycp_core1_etb"
GOSUB dump_etb 0x80101000 "pscp_core0_etb"
GOSUB dump_etb 0x80102000 "pscp_core1_etb"
ON ERROR

ENDDO

dump_etb:
	ENTRY &etb_addr &file_name
	; --------------------------------------------------------------------------------
	; @Title: Script File to store the ETB Raw Data to a File
	; @Description: 
	;   This script stores the ETB raw data to the etb.bin file.
	;   A template script to import the ETB data into the simulator is generated.
	; @Keywords: ETB, raw, trace
	; @Author: -
	; @Copyright: (C) 1989-2014 Lauterbach GmbH, licensed for use with TRACE32(R) only
	; --------------------------------------------------------------------------------
	; $Id: etb_readout.cmm 9566 2016-07-08 15:22:43Z hdammak $
	&cur_path_dir=os.ppd()

	; Checking if ETB is a CoreSight or TAP based ETB
	;----------&isCoresightEtb=(ADDRESS.OFFSET(COMPonent.BASE("ETF1",-1))!=0x0)
	;----------&EtbAddress=COMPonent.BASE("ETF1",-1)
	&isCoresightEtb=TRUE()
	&EtbAddress=DAP:&etb_addr

	&EtbAddress="E&(EtbAddress)"
	&EtbAddress=STRing.Replace("&EtbAddress","EE","E",0.)
	&depth=0

	&depth=Data.Long(&EtbAddress+0x004)

	IF &depth==0
	(
	  DIALOG.OK "Size of the ETB is zero!"
	  RETURN
	)

	; set read pointer to the beginning
	IF !&isCoresightEtb
	(
	  Data.Set ETB:5 %Long Data.Long(EETB:6)
	)
	ELSE
	(
	  D.S EDAP:(&EtbAddress+0x020) %LE %Long 0x0
	  PRIVATE &STS
	  &STS=Data.Long(&EtbAddress+0x00C)
	  IF ((&STS&0x1)==0x1)
	  (
		Data.Set &EtbAddress+0x014 %Long Data.Long(&EtbAddress+0x018)
	  )
	  ELSE
	  (
	;    &depth=(Data.Long(&EtbAddress+0x018)-Data.Long(&EtbAddress+0x014))>>2.
	  )
	)

	; Readout content
	&addr=0
	WHILE &addr<=(&depth*4)-1
	(
	  IF !&isCoresightEtb
	  (
		Data.Set AVM:&addr %Long Data.Long(EETB:0x4)
	  )
	  ELSE
	  (
		Data.Set AVM:&addr %Long Data.Long(&EtbAddress+0x010)
	  )
	  &addr=&addr+4
	)

	; Save it into a binary file
	Data.SAVE.Binary &CUR_DIR\"&file_name".bin AVM:0x000++((&depth*4)-1)

	RETURN
