

;;;;;;;;;;;;;;;;;;;;;;;;;;;;;;;;;;;;;;;;;;;;;;;;;;;;;;;;;;;;;;;;;;;;;;;;;;;;;;;;;;;;;;;;;;;;;;;;;;;;;;;;;;;;
;;                                                                                                        ;;
;;                                Copyright (c) 2019-2020 by Pizer.Fan                                    ;;
;;                                                                                                        ;;
;;  This software is copyrighted by and is the sole property of Pizer.Fan. All rights, title, ownership,  ;;
;;  or other interests in the software remain the property of Pizer.Fan. Any unauthorized use,            ;;
;;  duplication, transmission, distribution, or disclosure of this software is expressly forbidden.       ;;
;;  This Copyright notice may not be removed or modified without prior written consent of Pizer.Fan       ;;
;;                                                                                                        ;;
;;;;;;;;;;;;;;;;;;;;;;;;;;;;;;;;;;;;;;;;;;;;;;;;;;;;;;;;;;;;;;;;;;;;;;;;;;;;;;;;;;;;;;;;;;;;;;;;;;;;;;;;;;;;

;;;;;;;;;;;;;;;;;;;;;;;;;;;;;;;;;;;;;;;;;;;;;;;;;;;;;;;;;;;;;;;;;;;;;;;;;;;;;;;;;;;;;;;;;;;;;;;;;;;;;;;;;;;;
;;  TX Component                                                                                          ;;
;;                                                                                                        ;;
;;    Queue: Save the threads info into the HOST file.                                                     ;;
;;                                                                                                        ;;
;;;;;;;;;;;;;;;;;;;;;;;;;;;;;;;;;;;;;;;;;;;;;;;;;;;;;;;;;;;;;;;;;;;;;;;;;;;;;;;;;;;;;;;;;;;;;;;;;;;;;;;;;;;;

;;;;;;;;;;;;;;;;;;;;;;;;;;;;;;;;;;;;;;;;;;;;;;;;;;;;;;;;;;;;;;;;;;;;;;;;;;;;;;;;;;;;;;;;;;;;;;;;;;;;;;;;;;;;
;;  Release History                                                                                       ;;
;;                                                                                                        ;;
;;    Date              Name                      Description                                             ;;
;;                                                                                                        ;;
;;  2020/08/07      Pizer.Fan                   Initial Version                                           ;;
;;                                                                                                        ;;
;;;;;;;;;;;;;;;;;;;;;;;;;;;;;;;;;;;;;;;;;;;;;;;;;;;;;;;;;;;;;;;;;;;;;;;;;;;;;;;;;;;;;;;;;;;;;;;;;;;;;;;;;;;;


; Create logging output window
area.create logging_win 200. 500.
area.select logging_win
area.view logging_win

;PMACRO.list
local &err
&err=0

; Enter the export directory if null
global &_global_export_dir
&curr_script_dir=os.ppd()
do "&curr_script_dir\_setting_input_export_dir_if_null.cmm"
&export_dir="&_global_export_dir"
if "&(export_dir)"==""
(
  &export_dir=os.pwd()
)

; Makeup output file path
local &output_file_path
local &output_file_name
local &core_name
if symbol.exist(LOG_magicHeader)
(
  &core_name=data.string(d:v.value(LOG_magicHeader.coreName))
  &output_file_name="tx_analyze_threads_stack_overflow_&(core_name).txt"
)
else
(
  &output_file_name="tx_analyze_threads_stack_overflow.txt"
)
&output_file_path="&(export_dir)/&output_file_name"

print "Export to directory : &(export_dir)"
print "Start time : " clock.date() "  " clock.time() "  ..."
print ""


;;;;;;;;;;;;;;;;;;;;;;;;;;;;;;;;;;;;;;;;;;;;;;;;;;;;;;;;;;;;;;;;;;;;;;;;;;;;;;;;;;;;;;;;;;;;;;;;;;;;;;;;;;;;
;;  Start ...                                                                                             ;;
;;;;;;;;;;;;;;;;;;;;;;;;;;;;;;;;;;;;;;;;;;;;;;;;;;;;;;;;;;;;;;;;;;;;;;;;;;;;;;;;;;;;;;;;;;;;;;;;;;;;;;;;;;;;

&TX_READY=0
&TX_COMPLETED=1
&TX_TERMINATED=2
&TX_SUSPENDED=3   
&TX_SLEEP=4
&TX_QUEUE_SUSP=5
&TX_SEMAPHORE_SUSP=6
&TX_EVENT_FLAG=7
&TX_BLOCK_MEMORY=8
&TX_BYTE_MEMORY=9
&TX_IO_DRIVER=10
&TX_FILE=11
&TX_TCP_IP=12
&TX_MUTEX_SUSP=13

local &head_symbol
&head_symbol="_tx_thread_created_ptr"
if !(symbol.exist(&head_symbol))
(
  &err=1
  print "Error: `_tx_thread_created_ptr' does not exist. EXIT script"
  goto CMM_END
)

; Create output file
area.create output_file_win 200. 500.
area.open output_file_win "&output_file_path"
area.select output_file_win

local &head_symbol_val &ptr
local &created_cnt

;;;;;;;;;;;;;;;;;;;;;;;;;;;;;;;;;;;;;;;;;;;;;;;;;;;;;;;;;;;;;;;;;;;;;;;;;;;;;;;;;;;;;;;;;;;;;;;;;;;;;;;;;;;;
;;  Stack Overflow Thread Info                                                                            ;;
;;;;;;;;;;;;;;;;;;;;;;;;;;;;;;;;;;;;;;;;;;;;;;;;;;;;;;;;;;;;;;;;;;;;;;;;;;;;;;;;;;;;;;;;;;;;;;;;;;;;;;;;;;;;

&created_cnt=0
print "===============Stack Overflow Thread Info==============="
print "    No,    Addr, Stack     Start   -End,            State, Prio, Runcount,  Name"

&ptr=v.value((TX_THREAD*)&head_symbol)
&head_symbol_val=v.value((TX_THREAD*)&head_symbol)

CMM_LOOP_1:

&thread_id=v.value(((TX_THREAD*)&ptr)->tx_thread_id)
if (&thread_id!=0x54485244)
(
  ; The thread list has been destroied
  print "Current thread list has been destroied !!!"
  goto CMM_LOOP_THREAD_INFO
)


local &thread_string_addr &thread_run_count &thread_state &thread_priority &thread_created_next
local &thread_stack_start &thread_stack_end
if (v.value(sizeof(TX_THREAD))==0xd4) ; size is 212 (smp)
(
  &thread_string_addr=v.value(((TX_THREAD*)&ptr)->tx_thread_name)
  &thread_run_count=v.value(((TX_THREAD*)&ptr)->tx_thread_run_count)
  &thread_state=v.value(((TX_THREAD*)&ptr)->tx_thread_state)
  &thread_priority=v.value(((TX_THREAD*)&ptr)->tx_thread_priority)
  &thread_created_next=v.value(((TX_THREAD*)&ptr)->tx_thread_created_next)
  &thread_stack_start=v.value(((TX_THREAD*)&ptr)->tx_thread_stack_start)
  &thread_stack_end=v.value(((TX_THREAD*)&ptr)->tx_thread_stack_end)
)
else
(
  &thread_string_addr=v.value(((TX_THREAD*)&ptr)->tx_thread_name)
  &thread_run_count=v.value(((TX_THREAD*)&ptr)->tx_run_count)
  &thread_state=v.value(((TX_THREAD*)&ptr)->tx_state)
  &thread_priority=v.value(((TX_THREAD*)&ptr)->tx_priority)
  &thread_created_next=v.value(((TX_THREAD*)&ptr)->tx_created_next)
  &thread_stack_start=v.value(((TX_THREAD*)&ptr)->tx_stack_start)
  &thread_stack_end=v.value(((TX_THREAD*)&ptr)->tx_stack_end)
)
&thread_stack_end=v.value((&thread_stack_end)&(~3UL))
&thread_state_str=""
if (&thread_state==&TX_READY)
(
  &thread_state_str="READY"
  if (v.value(sizeof(_tx_thread_current_ptr)/sizeof(TX_THREAD *))==1)
  (
    if (v.value(_tx_thread_current_ptr)==&ptr)
    (
      &thread_state_str="EXECUTING"
    )
  )
  else
  (
    &core_index=0
    &core_cnt=v.value(sizeof(_tx_thread_current_ptr)/sizeof(TX_THREAD *))
    while (&core_index<&core_cnt)
    (
      if (v.value(_tx_thread_current_ptr[&core_index])==&ptr)
      (
        &core_id_str=format.decimal(0,v.value(&core_index))
        &thread_state_str="EXECUTING(&core_id_str)"
      )
      &core_index=&core_index+1
    )
  )
)
else if (&thread_state==&TX_COMPLETED)
(
  &thread_state_str="COMPLETED"
)
else if (&thread_state==&TX_TERMINATED)
(
  &thread_state_str="TERMINATED"
)
else if (&thread_state==&TX_SUSPENDED)
(
  &thread_state_str="SUSPENDED"
)
else if (&thread_state==&TX_SLEEP)
(
  &thread_state_str="SLEEP"
)
else if (&thread_state==&TX_QUEUE_SUSP)
(
  &thread_state_str="QUEUE_SUSP"
)
else if (&thread_state==&TX_SEMAPHORE_SUSP)
(
  &thread_state_str="SEMAPHORE_SUSP"
)
else if (&thread_state==&TX_EVENT_FLAG)
(
  &thread_state_str="EVENT_FLAG"
)
else if (&thread_state==&TX_BLOCK_MEMORY)
(
  &thread_state_str="BLOCK_MEMORY"
)
else if (&thread_state==&TX_BYTE_MEMORY)
(
  &thread_state_str="BYTE_MEMORY"
)
else if (&thread_state==&TX_IO_DRIVER)
(
  &thread_state_str="IO_DRIVER"
)
else if (&thread_state==&TX_FILE)
(
  &thread_state_str="FILE"
)
else if (&thread_state==&TX_TCP_IP)
(
  &thread_state_str="TCP_IP"
)
else if (&thread_state==&TX_MUTEX_SUSP)
(
  &thread_state_str="MUTEX_SUSP"
)
else
(
  &thread_state_str="UNKNOWN"
)
&thread_state_str=format.string("&thread_state_str",-10,' ')
if v.value(*(unsigned int *)&thread_stack_start)!=v.value(*(unsigned int *)&thread_stack_end)
(
  print "  " format.decimal(4, v.value(&created_cnt+1)) "  " &ptr " " format.hex(8, v.value(&thread_stack_start)) ": " format.hex(8, v.value(*(unsigned int *)&thread_stack_start)) " " format.hex(8, v.value(*(unsigned int *)&thread_stack_end)) "  &thread_state_str" "  " format.decimal(4,v.value(&thread_priority)) "  " format.decimal(8,v.value(&thread_run_count)) "  " data.string(d:&thread_string_addr)
)

&ptr_tmp=&thread_created_next
&ptr=&ptr_tmp
&created_cnt=&created_cnt+1

if (&ptr!=&head_symbol_val)&&(&ptr!=0)
  goto CMM_LOOP_1


CMM_LOOP_THREAD_INFO:
;;;;;;;;;;;;;;;;;;;;;;;;;;;;;;;;;;;;;;;;;;;;;;;;;;;;;;;;;;;;;;;;;;;;;;;;;;;;;;;;;;;;;;;;;;;;;;;;;;;;;;;;;;;;
;;  Thread Info                                                                                           ;;
;;;;;;;;;;;;;;;;;;;;;;;;;;;;;;;;;;;;;;;;;;;;;;;;;;;;;;;;;;;;;;;;;;;;;;;;;;;;;;;;;;;;;;;;;;;;;;;;;;;;;;;;;;;;

print ""
print "===============Thread Info==============="
print "    No,    Addr, Stack     Start   -End,            State, Prio, Runcount,  Name"

&created_cnt=0
&ptr=v.value((TX_THREAD*)&head_symbol)
&head_symbol_val=v.value((TX_THREAD*)&head_symbol)

CMM_LOOP_2:

&thread_id=v.value(((TX_THREAD*)&ptr)->tx_thread_id)
if (&thread_id!=0x54485244)
(
  ; The thread list has been destroied
  print "Current thread list has been destroied !!!"
  goto CMM_FILE_CLOSE
)


local &thread_string_addr &thread_run_count &thread_state &thread_priority &thread_created_next
local &thread_stack_start &thread_stack_end
if (v.value(sizeof(TX_THREAD))==0xd4) ; size is 212 (smp)
(
  &thread_string_addr=v.value(((TX_THREAD*)&ptr)->tx_thread_name)
  &thread_run_count=v.value(((TX_THREAD*)&ptr)->tx_thread_run_count)
  &thread_state=v.value(((TX_THREAD*)&ptr)->tx_thread_state)
  &thread_priority=v.value(((TX_THREAD*)&ptr)->tx_thread_priority)
  &thread_created_next=v.value(((TX_THREAD*)&ptr)->tx_thread_created_next)
  &thread_stack_start=v.value(((TX_THREAD*)&ptr)->tx_thread_stack_start)
  &thread_stack_end=v.value(((TX_THREAD*)&ptr)->tx_thread_stack_end)
)
else
(
  &thread_string_addr=v.value(((TX_THREAD*)&ptr)->tx_thread_name)
  &thread_run_count=v.value(((TX_THREAD*)&ptr)->tx_run_count)
  &thread_state=v.value(((TX_THREAD*)&ptr)->tx_state)
  &thread_priority=v.value(((TX_THREAD*)&ptr)->tx_priority)
  &thread_created_next=v.value(((TX_THREAD*)&ptr)->tx_created_next)
  &thread_stack_start=v.value(((TX_THREAD*)&ptr)->tx_stack_start)
  &thread_stack_end=v.value(((TX_THREAD*)&ptr)->tx_stack_end)
)
&thread_stack_end=v.value((&thread_stack_end)&(~3UL))
&thread_state_str=""
if (&thread_state==&TX_READY)
(
  &thread_state_str="READY"
  if (v.value(sizeof(_tx_thread_current_ptr)/sizeof(TX_THREAD *))==1)
  (
    if (v.value(_tx_thread_current_ptr)==&ptr)
    (
      &thread_state_str="EXECUTING"
    )
  )
  else
  (
    &core_index=0
    &core_cnt=v.value(sizeof(_tx_thread_current_ptr)/sizeof(TX_THREAD *))
    while (&core_index<&core_cnt)
    (
      if (v.value(_tx_thread_current_ptr[&core_index])==&ptr)
      (
        &core_id_str=format.decimal(0,v.value(&core_index))
        &thread_state_str="EXECUTING(&core_id_str)"
      )
      &core_index=&core_index+1
    )
  )
)
else if (&thread_state==&TX_COMPLETED)
(
  &thread_state_str="COMPLETED"
)
else if (&thread_state==&TX_TERMINATED)
(
  &thread_state_str="TERMINATED"
)
else if (&thread_state==&TX_SUSPENDED)
(
  &thread_state_str="SUSPENDED"
)
else if (&thread_state==&TX_SLEEP)
(
  &thread_state_str="SLEEP"
)
else if (&thread_state==&TX_QUEUE_SUSP)
(
  &thread_state_str="QUEUE_SUSP"
)
else if (&thread_state==&TX_SEMAPHORE_SUSP)
(
  &thread_state_str="SEMAPHORE_SUSP"
)
else if (&thread_state==&TX_EVENT_FLAG)
(
  &thread_state_str="EVENT_FLAG"
)
else if (&thread_state==&TX_BLOCK_MEMORY)
(
  &thread_state_str="BLOCK_MEMORY"
)
else if (&thread_state==&TX_BYTE_MEMORY)
(
  &thread_state_str="BYTE_MEMORY"
)
else if (&thread_state==&TX_IO_DRIVER)
(
  &thread_state_str="IO_DRIVER"
)
else if (&thread_state==&TX_FILE)
(
  &thread_state_str="FILE"
)
else if (&thread_state==&TX_TCP_IP)
(
  &thread_state_str="TCP_IP"
)
else if (&thread_state==&TX_MUTEX_SUSP)
(
  &thread_state_str="MUTEX_SUSP"
)
else
(
  &thread_state_str="UNKNOWN"
)
&thread_state_str=format.string("&thread_state_str",-10,' ')
print "  " format.decimal(4, v.value(&created_cnt+1)) "  " &ptr " " format.hex(8, v.value(&thread_stack_start)) ": " format.hex(8, v.value(*(unsigned int *)&thread_stack_start)) " " format.hex(8, v.value(*(unsigned int *)&thread_stack_end)) "  &thread_state_str" "  " format.decimal(4,v.value(&thread_priority)) "  " format.decimal(8,v.value(&thread_run_count)) "  " data.string(d:&thread_string_addr)

&ptr_tmp=&thread_created_next
&ptr=&ptr_tmp
&created_cnt=&created_cnt+1

if (&ptr!=&head_symbol_val)&&(&ptr!=0)
  goto CMM_LOOP_2


;;;;;;;;;;;;;;;;;;;;;;;;;;;;;;;;;;;;;;;;;;;;;;;;;;;;;;;;;;;;;;;;;;;;;;;;;;;;;;;;;;;;;;;;;;;;;;;;;;;;;;;;;;;;
;;  Counter Info                                                                                          ;;
;;;;;;;;;;;;;;;;;;;;;;;;;;;;;;;;;;;;;;;;;;;;;;;;;;;;;;;;;;;;;;;;;;;;;;;;;;;;;;;;;;;;;;;;;;;;;;;;;;;;;;;;;;;;

print ""
print "===============Counter Info==============="
&created_cnt=format.decimal(8,&created_cnt)
print " Created counter: &created_cnt"


;;;;;;;;;;;;;;;;;;;;;;;;;;;;;;;;;;;;;;;;;;;;;;;;;;;;;;;;;;;;;;;;;;;;;;;;;;;;;;;;;;;;;;;;;;;;;;;;;;;;;;;;;;;;
;;  End                                                                                                   ;;
;;;;;;;;;;;;;;;;;;;;;;;;;;;;;;;;;;;;;;;;;;;;;;;;;;;;;;;;;;;;;;;;;;;;;;;;;;;;;;;;;;;;;;;;;;;;;;;;;;;;;;;;;;;;

CMM_FILE_CLOSE:
print ""
area.close output_file_win
area.clear output_file_win

type "&output_file_path"

CMM_END:
area.select logging_win

print ""
print "End time : " clock.date() "  " clock.time() "  "

; Close the logging output window
; wait 1s
if (&err==0)
(
  area.close logging_win
  do "&curr_script_dir\_trace32_area_delete.cmm" "logging_win"
)

enddo

