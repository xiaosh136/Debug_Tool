; --------------------------------------------------------------------------------
; @Title: Script File to load ETB raw data in the TRACE32 Simulator
; @Description: 
;   This script loads the ETB raw data in the TRACE32 Simulator.
;   You need to edit the script to setup exactely the same ETM
;   configuration used when the trace data has been generated.
;   Otherwhise the raw data cannot be correctly decoded.
; @Keywords: ETB, raw, simulator, trace
; @Author: -
; @Copyright: (C) 1989-2014 Lauterbach GmbH, licensed for use with TRACE32(R) only
; --------------------------------------------------------------------------------
; $Id: etb_sim_import.cmm 6904 2014-04-21 15:16:07Z kjmal $

global &_global_export_dir
&export_dir="&_global_export_dir"
if "&(export_dir)"==""
(
  &export_dir=os.pwd()
)

    LOCAL &mem_file_path
  
; System Settings

;	SYStem.CPU *
	SYStem.CPU CortexR8MPCore
;    SYStem.CPU CortexR8
    SYStem.CONFIG CoreNumber 2
    CORE.ASSIGN 1 2
	
	; set any address here to enable the ETM in TRACE32
	SYStem.CONFIG ETMBASE 1000
	SYStem.CONFIG TPIU.Base 3000
	SYStem.Up
	
; Load the target code
	Data.LOAD "&export_dir/*.axf"

; Load the memory file
;  &mem_file_path="E:\Roc1+Orca\etbŒ Ã‚\mycatch\2020_01_10_17_18_35_0681.mem"
;  enter &mem_file_path	
	DIALOG.FILE "&export_dir/*.mem"
    ENTRY &mem_file_path

;    Data.LOAD.binary &mem_file_path 0x88000000++0x15000000 /SKIP 0x00000000 /noclear
	Data.LOAD.binary &mem_file_path 0x00000000++0x00001000 /SKIP 0x15000000 /noclear    
	Data.LOAD.binary &mem_file_path 0x60004000++0x00001000 /SKIP 0x15001000 /noclear
	Data.LOAD.binary &mem_file_path 0x60005000++0x00001000 /SKIP 0x15002000 /noclear
	Data.LOAD.binary &mem_file_path 0x54100000++0x00060000 /SKIP 0x15003000 /noclear
	Data.LOAD.binary &mem_file_path 0x48000000++0x00140000 /SKIP 0x15063000 /noclear
	Data.LOAD.binary &mem_file_path 0x40020000++0x00010000 /SKIP 0x151A3000 /noclear
	Data.LOAD.binary &mem_file_path 0x40030000++0x00010000 /SKIP 0x151B3000 /noclear
	Data.LOAD.binary &mem_file_path 0x87800000++0x00800000 /SKIP 0x151C3000 /noclear	
	Data.LOAD.binary &mem_file_path 0x924C7EE4++0x00004000 /SKIP 0x159C3000 /noclear
	Data.LOAD.binary &mem_file_path 0x63300000++0x00010000 /SKIP 0x159C7000 /noclear
	Data.LOAD.binary &mem_file_path 0x55910000++0x000001FC /SKIP 0x159D7008 /noclear

	
; ETM Settings, Please note that these settings must match the used ETM settings
; when recording the trace. Otherwhise, the displayed trace here could contain 
; erros.
	ETM.PortSize 32.
	ETM.ContextID OFF
;	ETM.PortMode  Normal
	tpiu.portmode wrapped
	ETM.DataTrace OFF
	ETM.TImeMode off
	
; Import trace data
	LA.Mode FLOWTRACE ON
;	LA.IMPORT.ETB etb.bin
	LA.IMPORT.ETB "&export_dir/*.bin"
	
;	LA.List tp tpinfo list.address list.code DEFault
	LA.List
	LA.List /core 0	
	LA.List /core 1
	
	ENDDO